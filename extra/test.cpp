#include <stdint.h>
#include <iostream>
#include <string.h>

struct Font
{
  /**
   * @brief Datatype for a bitmap font for rendering text
   * @details Datatype for storing information about how a font should be used to render correctly. Instances of this struct do not need to be manually constructed unless you wish to use your own fonts.
   *
   * @param map An array of the bitmap font data stored in PROGMEM
   * @param width The width in pixels of a single glyph
   * @param height The height in pixels of a single glyph
   * @param length How many characters appear in the font
   * @param offset Skip this many characters in the array, useful for cases like ASCII where codes below 32 are non-printable characters
   */
  Font(const uint8_t* const map, const int16_t width, const int16_t height, const size_t length, const size_t offset)
  : charmap(map)
  , charwidth(width)
  , charheight(height)
  , maplength(length)
  , mapoffset(offset)
  {}

  const uint8_t* const charmap;
  const int16_t charwidth;
  const int16_t charheight;

  const size_t maplength;
  const size_t mapoffset;
};

const uint8_t font3x5_data[96 * 3] = {
  0x00, 0x00, 0x00, //
  0x00, 0x2e, 0x00, // !
  0x06, 0x00, 0x06, // "
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  0x00, 0x00, 0x00
};

/**
 * @var 3 by 5 pixel font
 */
static Font font3x5 = {
  font3x5_data,
  3,
  5,
  96,
  32
};


const uint8_t font5x7_data[96 * 5] = {
  0x00, 0x00, 0x00, 0x00, 0x00,
  0x00, 0x00, 0x5F, 0x00, 0x00,
  0x00, 0x07, 0x00, 0x07, 0x00,
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  0x02, 0x01, 0x02, 0x04, 0x02
};

/**
 * @var 5 by 7 pixel font
 */
static Font font5x7 = {
  font5x7_data,
  5,
  7,
  96,
  32
};


template <typename T>
T modp(const T a, const T b)
{
  return (((a % b) + b) % b);
}

class TextCommand
{
public:

  TextCommand(const int16_t x, const int16_t y, const char* const text, const Font& font, int16_t size) :
  _x(x), _y(y), txt(text), length(strlen(text)), fnt(font), fontsize(size)
  {
  }

  static uint8_t process(void* command, const uint8_t input, const int16_t x, const int16_t y)
  {
    TextCommand* tc = (TextCommand*)command;
    const char* const text = tc->txt;
    const Font& font = tc->fnt;

    // out of x-bounds
    if (x < tc->_x || x >= tc->_x + (font.charwidth + 1) * tc->fontsize * tc->length)
      return input;

    // out of y-bounds
    if (y < tc->_y || y >= tc->_y + font.charheight * tc->fontsize)
      return input;

    // 1px letter spacing
    if (((x - tc->_x) / tc->fontsize + 1) % (font.charwidth + 1) == 0)
      return input;

    const int16_t index = (x - tc->_x) / ((font.charwidth + 1) * tc->fontsize);
    if (index >= tc->length)
      return input;

    const char c = text[index];

    const uint8_t glyph_slice = pgm_read_byte(&(font.charmap[(c - font.mapoffset) * font.charwidth + modp((x - tc->_x) / tc->fontsize, font.charwidth + 1)]));

    if ((glyph_slice >> ((y - tc->_y) / tc->fontsize)) & 1)
      return input & ~(1 << (7 - x % 8));
    return input;
  }

private:
  const int16_t _x, _y;
  const char* const txt;
  const int16_t length;
  const Font& fnt;
  const int16_t fontsize;
};

int main()
{
  TextCommand* commands[] = {
    new TextCommand(0, 8, "ABCDEFGHIJK", font5x7, 1),
    new TextCommand(0, 120, "ABCDE", font3x5, 2),
  };
  const int16_t WIDTH = 152;
  const int16_t HEIGHT = 296;
  uint8_t buf[((WIDTH+1) / 2) * HEIGHT] = {0};

  for (int16_t y = 0; y < HEIGHT; ++y)
  {
    for (int16_t x = 0; x < WIDTH; x += 8)
    {
      buf[y * WIDTH / 8 + x / 8] = 0xff;
      for (int16_t xi = 0; xi < 8; ++xi)
      {
        for (TextCommand* command : commands)
          buf[y * WIDTH / 8 + (x + xi) / 8] = TextCommand::process(command, buf[y * WIDTH / 8 + (x + xi) / 8], x + xi, y);
      }
    }
  }


  for (int16_t y = 0; y < HEIGHT; ++y)
  {
    for (int16_t x = 0; x < WIDTH; x += 8)
    {
      const uint8_t cell = buf[y * WIDTH / 8 + x  / 8];
      for (int16_t xi = 0; xi < 8; ++xi)
      {
        if (!(cell & (1 << (7 - xi))))
          std::cout << "#";
        else
          std::cout << ".";
      }
    }
    std::cout << std::endl;
  }

  for (TextCommand* tc : commands)
    delete tc;
}
